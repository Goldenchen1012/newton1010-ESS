/**
  ******************************************************************************
  * @file    smp_max7219.c
  * @author  Golden Chen
  * @version V0.0.1
  * @date    2021/12/30
  * @brief   
  ******************************************************************************
  * @attention
  *
  * <h2><center>&copy; COPYRIGHT(c) 2021 SMP</center></h2>
  *
  * 
  *
  ******************************************************************************
  */

#include <stdio.h>
#include <string.h>
#include <stdint.h>
#include "stm32l4xx_hal.h"
#include "smp_max7219.h"
//
// MAX7219 LED Matrix controller library
// Each module shifts bits in and the next bit is shifted out. For example, in the case of my setup with 4 modules

const uint8_t ucFont[] = {
0x20,0x20,0x20,0x20,0x00,0x00,0x20,0x00, //33/ --> !
0x50,0x50,0x50,0x00,0x00,0x00,0x00,0x00, //34/ --> "
0x28,0x28,0x7C,0x28,0x7C,0x28,0x28,0x00, //35/ --> #
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0x10,0x28,0x44,0x44,0x44,0x44,0x38,0x00, //128/ --> ?
};
	
static uint8_t iNumControllers;

void max7219_small_delay(uint8_t nop_num){
    for(int i= 0 ; i< nop_num ;i++){
		    __NOP();
		}
}

void max7219_SendByte(uint8_t *dataout, uint8_t len)
{
  char i,j;
  for(j=0; j<len ; j++){
      for (i=8; i>0; i--) {
        unsigned char mask = 1 << (i - 1);                    // calculate bitmask
        MAX7219_CLK_0();                                      // bring CLK low
				max7219_small_delay(1);
        if (dataout[j] & mask)                              // output one data bit
          MAX7219_DATA_1();                                   //  "1"
        else                                                  //  or
          MAX7219_DATA_0();                                   //  "0"
        MAX7219_CLK_1();                                      // bring CLK high
				max7219_small_delay(1);
	   }
  }
}	
	
	
//
// Transmit a sequence of N x 16 bits to the cascaded controllers
//
// Send an atomic sequence of uint8_ts for loading all chained controllers (16 bits per controller)
// Each controller acts like a 16-bit shift register and passes on the bits to the next controller. The
// last 16-bits to sit in the controller will be latched when the CS line goes high.
// uint8_t 0 -> D15-D8 (XXXX A3 A2 A1 A0), 4-bits unused and 4-bit register address
// uint8_t 1 -> D7-D0 (8-bit data)
//
void maxSendSequence(uint8_t *pSequence, uint8_t len)
{
  // The CS line stays low throughout a "transaction". Send all of the control uint8_ts for all of the chained
  // controllers in a single transaction. When the CS line rises, the data will be latched
   MAX7219_CS_0();
	 max7219_small_delay(1);
   max7219_SendByte(pSequence, len);
	 MAX7219_CS_1();   
	 max7219_small_delay(1);
} /* maxSendSequence() */


// Power on or off the LED controllers
//
void maxPowerUp(uint8_t bPowerUp)
{
uint8_t i;
uint8_t *d, bTemp[32]; // up to 16 controllers
  d = bTemp;
  for (i=0; i<iNumControllers; i++)
  {
     *d++ = 0x0C; // power up/down
     *d++ = bPowerUp;
  }
  maxSendSequence(bTemp, iNumControllers * 2); // send the power up/down instruction
} /* maxPowerUp() */
//
// Set the intensity (duty cycle of PWM signal) for the LED segments
// valid values are 0 (dimmest) to 15 (brightest)
//
void maxSetIntensity(uint8_t bIntensity)
{
uint8_t *d, bTemp[32];
uint8_t i;

  d = bTemp;
  for (i=0; i<iNumControllers; i++)
  {
      *d++ = 0x0A; // set intensity
      *d++ = bIntensity;
  } // for i
  maxSendSequence(bTemp, iNumControllers * 2);
} /* maxSetIntensity() */
//
// Set the segment decode mode (BCD or none)
//
void maxSetSegmentMode(uint8_t bMode)
{
uint8_t i, *d, bTemp[32];

  d = bTemp;
  for (i=0; i<iNumControllers; i++)
  {
      *d++ = 0x09; // decode mode
      *d++ = (bMode) ? 0xff : 0x00;
  } // for i
  maxSendSequence(bTemp, iNumControllers * 2); // send the scan limit instructions to all controllers
} /* maxSetSegmentMode() */

//
// Send image data to the array of controllers
// The image data is transmitted as N by 8 lines tall (N is the number of MAX7219 controllers)
// The pitch (uint8_ts per line) can be any value
//
void maxSendImage(uint8_t *pImage, int iPitch)
{
uint8_t i, j;
uint8_t *s, *d, bTemp[32];

   for (j=0; j<8; j++) // 8 rows to transmit
   {
      s = &pImage[iPitch * j];
      d = bTemp;
      for (i=0; i<iNumControllers; i++)
      {
         *d++ = (j+1); // row number is the "instruction"
         *d++ = *s++; // image data
      } // for each controller
      maxSendSequence(bTemp, iNumControllers * 2);
   } // for each row of image
} /* maxSendImage() */

//
// Enable (1) or disable (0) test mode
// This mode lights up every LED at max brightness
// It can sometimes power up in test mode
//
void maxSetTestMode(uint8_t bOn)
{
uint8_t i, *d, bTemp[32];

  d = bTemp;
  for (i=0; i<iNumControllers; i++)
  {
      *d++ = 0x0F; // test mode
      *d++ = bOn;
  } // for i
  maxSendSequence(bTemp, iNumControllers * 2); // send the scan limit instructions to all controllers
} /* maxSetTestMode() */
//
// Number of "digits/rows" to control
// valid values are 1-8 active digits/rows
//
void maxSetLimit(uint8_t bLimit)
{
uint8_t i, *d, bTemp[32];

  d = bTemp;
  for (i=0; i<iNumControllers; i++)
  {
      *d++ = 0x0B; // set scan limit
      *d++ = (bLimit - 1);
  } // for i
  maxSendSequence(bTemp, iNumControllers * 2); // send the scan limit instructions to all controllers
} /* maxSetLimit() */

//
// Send an ASCII string of numbers/spaces/decimal points
// to a 7-segment display
//
void maxSegmentString(char *pString)
{
unsigned char ucTemp[4];
int iDigit;

	memset(ucTemp, 0, sizeof(ucTemp));
	iDigit = 0;
	while (*pString && iDigit < 8)
	{
		ucTemp[0] = 8 - (iDigit & 7); // cmd byte to write
		if (pString[0] >= '0' && pString[0] <= '9')
		{
			ucTemp[1] = *pString++; // store digit
			if (pString[0] == '.')
			{
				ucTemp[1] |= 0x80; // turn on decimal point
				pString++;
			}
		}
		else
		{
			ucTemp[1] = 0xf; // space = all segments off
			pString++;
		}
		iDigit++;
		maxSendSequence(ucTemp, 2); // need to latch each byte pair
	}
	while (iDigit < 8) // blank out remaining digits
	{
		ucTemp[0] = 8 - (iDigit & 7);
		ucTemp[1] = 0xf; // all segments off
		iDigit++;
		maxSendSequence(ucTemp, 2);
	}
} /* maxSegmentString() */
//
// Draw a string of characters into the image buffer
// Normal characters are 8x8 and drawn on uint8_t boundaries
// Small characters are 6x8 and drawn on bit boundaries
//
void maxDrawString(char *pString, uint8_t *pImage, uint8_t iPitch, uint8_t bSmall)
{
static uint8_t b, bMask, i, j, *d, bCol;
const uint8_t *pFont;
const uint8_t *s;
static int iWidth;

   d = pImage;
   bCol = 0;
   if (bSmall)
   {
      pFont = ucFont;
      iWidth = 6;
   }
   else
   {
      pFont = ucFont;
      iWidth = 8;
   }
   while (*pString)
   {
      b = *pString++;
      s = &pFont[(int)b * iWidth]; // 6 or 8 uint8_ts per character in ASCII order
      for (i=0; i<iWidth; i++) // column
      {
         bMask = (0x80 >> (bCol & 7));
         b = *s++; // current font uint8_t
         for (j=0; j<8; j++) // bit number of source becomes destination row
         {
            if (b & 1) // start from LSB
               d[j*iPitch] |= bMask;
            else
               d[j*iPitch] &= ~bMask;
            b >>= 1; // shift down font uint8_t
         } // for j
         bCol++;
         if ((bCol & 7) == 0) // next uint8_t
            d++;
      } // for i
   } // while string
} /* maxDrawString() */

//
// Scroll a bitmap N bits left (positive) or right (negative)
// Valid scroll values are +1 to +7 and -1 to -7
// A bitmap is assumed to be iPitch uint8_ts wide by 8 rows tall
// Bits which scroll off one end are added back to the other end
//
void maxScrollBitmap(uint8_t *pBitmap, int iPitch, int iScroll)
{
uint8_t b, bEdge, *s;
int col, row;

  if (iScroll > 0) // scroll left
  {
     for (row=0; row<8; row++)
     {
        s = &pBitmap[row * iPitch];
        bEdge = s[0] >> (8-iScroll);
        for (col=0; col<iPitch; col++)
        {
           b = s[col] << iScroll;
           b |= (col == iPitch-1) ? bEdge : (s[col+1] >> (8-iScroll));
           s[col] = b;
        } // for col
     } // for row
  }
  else // scroll right
  {
     iScroll = 0 - iScroll; // make it a positive number
     for (row=0; row<8; row++)
     {
        s = &pBitmap[row * iPitch];
        bEdge = s[iPitch-1] << (8-iScroll);
        for (col=iPitch-1; col>=0; col--)
        {
           b = s[col] >> iScroll;
           b |= (col == 0) ? bEdge : (s[col-1] << (8-iScroll));
           s[col] = b;
        } // for col
     } // for row    
  }
} /* maxScrollBitmap() */
//
// Initialize the controllers
//
int maxInit(uint8_t iNum, uint8_t bDecodeMode)
{
  iNumControllers = iNum;
	
	MAX7219_CS_1();  
	
  maxPowerUp(1); // turn on the LED controllers
  maxSetLimit(8); // tell it to display 8 rows of 8 pixels
  maxSetIntensity(5); // set the minimum intensity to start (1/32 duty cycle)
  maxSetSegmentMode(bDecodeMode); // sets BCD (7-segment), or none (pixels
  maxSetTestMode(0); // disable test mode (it can accidentally get set at power up) 
  return 0;
} /* maxInit() */

void maxShutdown(void)
{
	
   maxPowerUp(0); // turn off the LED controllers
   //AIOCloseSPI(file_spi);
   //file_spi = -1;
   //AIOShutdown();
	
} /* maxShutdown() */


void MAX7219_All_Display(uint8_t data)
{
	uint8_t i,j, *d, bTemp[32];	
  for (j=0; j< 9; j++){
      d = bTemp;
      for (i=0; i<iNumControllers; i++)
      {
          *d++ = j;          // set REG. display
          *d++ = data;
      } // for i
      maxSendSequence(bTemp, iNumControllers * 2); // send the scan limit instructions to all controllers
	}
}

void MAX7219_Display_1(void)
{
	uint8_t i,j, *d, bTemp[32];	
  for (j=1; j< 9; j++){
      d = bTemp;
      for (i=0; i<iNumControllers; i++)
      {
          *d++ = j;          // set REG. display
          *d++ = ucFont[255+j+i*8];
      } // for i
      maxSendSequence(bTemp, iNumControllers * 2); // send the scan limit instructions to all controllers
	}
}
